// Host tests for the streaming base64 in net/base64_stream.h.
//
// Differentially tested against a reference table generated by Python's
// base64.b64encode. The published RFC vectors all happen to exercise the tails
// too, but a hand-rolled encoder can pass those and still be wrong for a
// specific length -- the SHA-256 in the console was broken at exactly one input
// length (len % 64 == 55) and only differential testing found it.
#include <unity.h>

#include <string.h>

#include <string>

#include "net/base64_stream.h"

void setUp() {}
void tearDown() {}

static std::string enc(const std::string& in) {
  std::string out;
  base64_stream::encode(reinterpret_cast<const uint8_t*>(in.data()), in.size(),
                        [&out](const char* p, size_t n) {
                          out.append(p, n);
                          return true;
                        });
  return out;
}

// RFC 4648 section 10. Every tail length appears here.
static void rfc4648_vectors() {
  TEST_ASSERT_EQUAL_STRING("", enc("").c_str());
  TEST_ASSERT_EQUAL_STRING("Zg==", enc("f").c_str());
  TEST_ASSERT_EQUAL_STRING("Zm8=", enc("fo").c_str());
  TEST_ASSERT_EQUAL_STRING("Zm9v", enc("foo").c_str());
  TEST_ASSERT_EQUAL_STRING("Zm9vYg==", enc("foob").c_str());
  TEST_ASSERT_EQUAL_STRING("Zm9vYmE=", enc("fooba").c_str());
  TEST_ASSERT_EQUAL_STRING("Zm9vYmFy", enc("foobar").c_str());
}

// Generated with:
//   python3 -c "import base64;print([base64.b64encode(bytes(range(n))).decode() for n in
//   range(0,13)])"
// Every length 0..12, so all three tail cases are covered three times over
// against an implementation nobody here wrote.
static void matches_a_reference_encoder_at_every_tail() {
  static const char* kExpected[] = {
      "",
      "AA==",
      "AAE=",
      "AAEC",
      "AAECAw==",
      "AAECAwQ=",
      "AAECAwQF",
      "AAECAwQFBg==",
      "AAECAwQFBgc=",
      "AAECAwQFBgcI",
      "AAECAwQFBgcICQ==",
      "AAECAwQFBgcICQo=",
      "AAECAwQFBgcICQoL",
  };
  for (size_t n = 0; n < sizeof(kExpected) / sizeof(kExpected[0]); n++) {
    std::string in;
    for (size_t i = 0; i < n; i++) in.push_back(static_cast<char>(i));
    TEST_ASSERT_EQUAL_STRING(kExpected[n], enc(in).c_str());
  }
}

// High bytes: a signed char would sign-extend and corrupt the top group. A
// framebuffer is mostly 0x00 and 0xFF, so this is the common case here, not an
// edge one.
static void high_bytes_do_not_sign_extend() {
  const uint8_t bytes[] = {0xFF, 0xFF, 0xFF};
  std::string out;
  base64_stream::encode(bytes, sizeof(bytes), [&out](const char* p, size_t n) {
    out.append(p, n);
    return true;
  });
  TEST_ASSERT_EQUAL_STRING("////", out.c_str());

  const uint8_t mixed[] = {0x00, 0x80, 0xFF, 0x7F};
  out.clear();
  base64_stream::encode(mixed, sizeof(mixed), [&out](const char* p, size_t n) {
    out.append(p, n);
    return true;
  });
  TEST_ASSERT_EQUAL_STRING("AID/fw==", out.c_str());
}

static void encoded_len_agrees_with_what_is_emitted() {
  for (size_t n = 0; n < 40; n++) {
    std::string in(n, 'x');
    TEST_ASSERT_EQUAL_size_t(base64_stream::Encoder::encoded_len(n), enc(in).size());
  }
}

// A display plane is 3904 bytes -- not a multiple of 3, so the tail matters at
// the real size and not only in the toy cases above.
static void a_real_plane_length_round_trips() {
  const size_t kPlane = 32 * 122;
  TEST_ASSERT_EQUAL_size_t(3904, kPlane);
  std::string in(kPlane, '\0');
  for (size_t i = 0; i < kPlane; i++) in[i] = static_cast<char>(i * 7);
  const std::string out = enc(in);
  TEST_ASSERT_EQUAL_size_t(base64_stream::Encoder::encoded_len(kPlane), out.size());
  TEST_ASSERT_EQUAL_CHAR('=', out[out.size() - 1]);  // 3904 % 3 == 1 -> "=="
  TEST_ASSERT_EQUAL_CHAR('=', out[out.size() - 2]);
}

// A dead peer must stop the encode, not spin through 3904 bytes writing into a
// socket that is gone.
static void a_refusing_sink_stops_the_encode() {
  int calls = 0;
  std::string in(300, 'a');
  const bool ok = base64_stream::encode(reinterpret_cast<const uint8_t*>(in.data()), in.size(),
                                        [&calls](const char*, size_t) {
                                          calls++;
                                          return calls < 5;
                                        });
  TEST_ASSERT_FALSE(ok);
  TEST_ASSERT_EQUAL_INT(5, calls);
}

int main() {
  UNITY_BEGIN();
  RUN_TEST(rfc4648_vectors);
  RUN_TEST(matches_a_reference_encoder_at_every_tail);
  RUN_TEST(high_bytes_do_not_sign_extend);
  RUN_TEST(encoded_len_agrees_with_what_is_emitted);
  RUN_TEST(a_real_plane_length_round_trips);
  RUN_TEST(a_refusing_sink_stops_the_encode);
  return UNITY_END();
}
