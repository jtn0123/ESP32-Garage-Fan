// full_refresh_v2 moved below includes and constants
#include <esp_system.h>
#include <esp_timer.h>
#include <esp_heap_caps.h>
#include <cstdio>
#include <cstring>

// Copyright 2024 Justin

#include <Arduino.h>
#include <Preferences.h>

#include "config.h"
#include "runtime_config.h"
#ifdef LOG_ENABLED
#include "logging/logger.h"
#include "logging/log_mqtt.h"
#endif
#if USE_DISPLAY
#include <GxEPD2_BW.h>
#endif

#if USE_DISPLAY
#include "display_layout.h"
#include "display_layout_aliases.h"
#include "icons.h"
#include "ui_ops_generated.h"
#include "ui_generated.h"
#include "display_capture.h"
#include "history_ring.h"
#include "dual_gfx.h"
using namespace ui;  // NOLINT(build/namespaces) - namespace is generated by gen_ui.py
#endif
#include "generated_config.h"
#include "net.h"
#include "power.h"
#include "sensors.h"
#include "system_manager.h"
#include "state_manager.h"
#include "metrics_diagnostics.h"
#include "app_controller.h"
#if USE_DISPLAY
#include "display_manager.h"
#include "display_renderer.h"
#endif

// Display constant aliases moved to display_renderer.h

// Most display functions are now declared in display_manager.h
// No need to redeclare them here since they're implemented in this file
#if USE_DISPLAY
// Accessor to avoid forward reference ordering issues
// Implemented below, declared in display_manager.h
static bool maybe_redraw_status(const BatteryStatus& bs, const char* ip_cstr, const int rect[4]);
template <typename DrawFnFwd>
static inline void draw_in_region(const int rect[4], DrawFnFwd drawFn);
// Forward decls used by spec renderer - function moved to display_renderer module
#if USE_UI_SPEC
// Spec implementation is draw_from_spec_full_impl() below
// draw_from_spec_full() is in display_renderer.cpp and calls our impl
#endif
#endif

// Feather ESP32-S2 + 2.13" FeatherWing (adjust if needed)
#ifndef EINK_CS
#define EINK_CS 9  // D9
#endif
#ifndef EINK_DC
#define EINK_DC 10  // D10
#endif
#ifndef EINK_RST
#define EINK_RST -1  // FeatherWing ties panel reset to Feather RESET
#endif
#ifndef EINK_BUSY
#define EINK_BUSY \
  -1  // FeatherWing BUSY not connected; use -1 so library times
      // waits
#endif

// 2.13" b/w class; choose the one matching your panel
// B74 works for SSD1680/UC8151 variants used by many 2.13" panels
// Alternative: DEPG0213BN (also SSD1680 family). Select via
// -DEINK_PANEL_DEPG0213BN=1
#if USE_DISPLAY
#ifndef EINK_PANEL_DEPG0213BN
#define EINK_PANEL_DEPG0213BN 0
#endif
#if EINK_PANEL_DEPG0213BN
GxEPD2_BW<GxEPD2_213_DEPG0213BN, GxEPD2_213_DEPG0213BN::HEIGHT> display(
    GxEPD2_213_DEPG0213BN(EINK_CS, EINK_DC, EINK_RST, EINK_BUSY));
#else
// Prefer the explicit GDEY0213B74 class name for clarity on SSD1680 FeatherWing
GxEPD2_BW<GxEPD2_213_GDEY0213B74, GxEPD2_213_GDEY0213B74::HEIGHT> display(
    GxEPD2_213_GDEY0213B74(EINK_CS, EINK_DC, EINK_RST, EINK_BUSY));
#endif

// Now that display exists, provide the implementation using it
#if USE_UI_SPEC
// Short, user-facing label for a raw weather condition string. Mirrors the
// web sim's shortConditionLabel keyword order so device and sim render the
// same footer text for the same condition.
static String spec_short_condition(const char* weather) {
  String s(weather ? weather : "");
  s.toLowerCase();
  auto has = [&](const char* k) { return s.indexOf(k) >= 0; };
  if (has("night") || has("moon"))
    return String("Night");
  if (has("part"))
    return String("Partly");
  if (has("cloud") || has("overcast"))
    return String("Cloudy");
  if (has("storm") || has("thunder") || has("lightning"))
    return String("Storm");
  if (has("rain") || has("pour") || has("shower") || has("drizzle"))
    return String("Rain");
  if (has("hail"))
    return String("Hail");
  if (has("snow") || has("sleet"))
    return String("Snow");
  if (has("fog") || has("mist") || has("haze"))
    return String("Fog");
  if (has("wind"))
    return String("Wind");
  return String("Sunny");
}

// Resolve one {placeholder} key from a ui_spec op template using live device
// state. Shared by every templated op (OP_TEXT, OP_TEXTCENTEREDIN) so a
// template like {weather} or {time_hhmm} never prints literally.
static String spec_format_field(const String& key) {
  static char buf[32];
  if (key == "room_name")
    return String(rc_room_name());
  if (key == "ip") {
    char ip_c[32];
    net_ip_cstr(ip_c, sizeof(ip_c));
    return String(ip_c);
  }
  if (key == "fw_version")
    return String(FW_VERSION);
  // Battery fields
  if (key == "battery_percent" || key.startsWith("battery_voltage")) {
    BatteryStatus bs = read_battery_status();
    if (key == "battery_percent") {
      snprintf(buf, sizeof(buf), "%d", bs.percent);
      return String(buf);
    }
    // Handle battery_voltage:.2f format
    snprintf(buf, sizeof(buf), "%.2f", bs.voltage);
    return String(buf);
  }
  if (key == "days") {
    BatteryStatus bs = read_battery_status();
    snprintf(buf, sizeof(buf), "%d", bs.estimatedDays);
    return String(buf);
  }
  // Inside sensor fields
  if (key == "inside_hum_pct") {
    InsideReadings ir = read_inside_sensors();
    snprintf(buf, sizeof(buf), "%.0f", ir.humidityPct);
    return String(buf);
  }
  if (key.startsWith("pressure_hpa")) {
    InsideReadings ir = read_inside_sensors();
    snprintf(buf, sizeof(buf), "%.1f", ir.pressureHPa);
    return String(buf);
  }
  // Outside sensor fields
  if (key == "outside_hum_pct") {
    OutsideReadings o = net_get_outside();
    snprintf(buf, sizeof(buf), "%.0f", o.humidityPct);
    return String(buf);
  }
  // Distinct from the inside "pressure_hpa" case above: startsWith() is a prefix
  // match, so neither key can match the other's branch.
  if (key.startsWith("outside_pressure_hpa")) {
    OutsideReadings o = net_get_outside();
    if (!o.validPressure || !isfinite(o.pressureHPa))
      return String("--");
    snprintf(buf, sizeof(buf), "%.0f", o.pressureHPa);
    return String(buf);
  }
  if (key.startsWith("wind_mps")) {
    OutsideReadings o = net_get_outside();
    float mph = o.windMps * 2.237f;
    snprintf(buf, sizeof(buf), "%.1f", mph);
    return String(buf);
  }
  if (key == "weather_short") {
    OutsideReadings o = net_get_outside();
    return spec_short_condition(o.weather);
  }
  if (key == "weather") {
    OutsideReadings o = net_get_outside();
    return String(o.weather);
  }
  if (key == "time_hhmm") {
    net_time_hhmm(buf, sizeof(buf));
    return String(buf);
  }
  if (key == "inside_temp_f") {
    InsideReadings ir = read_inside_sensors();
    if (!isfinite(ir.temperatureC))
      return String("--");
    snprintf(buf, sizeof(buf), "%.0f", ir.temperatureC * 9.0f / 5.0f + 32.0f);
    return String(buf);
  }
  if (key == "outside_temp_f") {
    OutsideReadings o = net_get_outside();
    if (o.validTemp && isfinite(o.temperatureC)) {
      snprintf(buf, sizeof(buf), "%.0f", o.temperatureC * 9.0f / 5.0f + 32.0f);
      return String(buf);
    }
    if (isfinite(get_last_outside_f())) {
      snprintf(buf, sizeof(buf), "%.0f", get_last_outside_f());
      return String(buf);
    }
    return String("--");
  }
  if (key.startsWith("hist_")) {
    // Chart min/max labels; shared scale per chart (in+out group together).
    float mn = 0, mx = 0;
    bool temp_group = key.startsWith("hist_temp");
    bool ok = temp_group ? hist_minmax(hist_ring().temp_in, hist_ring().temp_out, &mn, &mx)
                         : hist_minmax(hist_ring().rh_in, hist_ring().rh_out, &mn, &mx);
    if (!ok)
      return String("--");
    snprintf(buf, sizeof(buf), "%d", static_cast<int>(key.endsWith("_max") ? (mx + 0.5f) : mn));
    return String(buf);
  }
  if (key == "date_mmmdd") {
    // "Jul 30" - the date half of the header's last-updated stamp.
    time_t now = time(nullptr);
    struct tm tm_now;
    localtime_r(&now, &tm_now);
    strftime(buf, sizeof(buf), "%b %d", &tm_now);
    return String(buf);
  }
  return String("--");
}

// Expand every {placeholder} in a ui_spec op template.
static String spec_expand_template(const String& templ) {
  String out;
  out.reserve(templ.length() + 8);
  int start = 0;
  while (true) {
    int lb = templ.indexOf('{', start);
    if (lb < 0) {
      out += templ.substring(start);
      break;
    }
    int rb = templ.indexOf('}', lb + 1);
    if (rb < 0) {
      out += templ.substring(start);
      break;
    }
    out += templ.substring(start, lb);
    String key = templ.substring(lb + 1, rb);
    out += spec_format_field(key);
    start = rb + 1;
  }
  return out;
}

// Evaluates a spec op's `when: has(<field>)` guard, which gen_ui.py emits into
// UiOpHeader::s1. Mirrors the web simulator (web/sim/sim.js): a guarded op whose
// field has no value is not drawn at all, so an absent reading leaves the rect
// blank instead of printing a "-- hPa" placeholder.
//
// Fields with no case below report absent, because the firmware has no validity
// signal for them and a blank rect matches the simulator while "--" would not.
// Every has() field in config/ui_spec.json must therefore appear here;
// tests/test_spec_when_guards.py fails when one is missing.
static bool spec_field_has(const char* field) {
  if (!field)
    return true;
  if (strcmp(field, "pressure_hpa") == 0) {
    InsideReadings ir = read_inside_sensors();
    return isfinite(ir.pressureHPa);
  }
  if (strcmp(field, "outside_pressure_hpa") == 0) {
    OutsideReadings o = net_get_outside();
    return o.validPressure && isfinite(o.pressureHPa);
  }
  if (strcmp(field, "outside_hum_pct") == 0) {
    OutsideReadings o = net_get_outside();
    return o.validHum && isfinite(o.humidityPct);
  }
  if (strcmp(field, "wind_mps") == 0) {
    OutsideReadings o = net_get_outside();
    return o.validWind && isfinite(o.windMps);
  }
  return false;
}

// Non-static so display_renderer.cpp can call it
void draw_from_spec_full_impl(uint8_t variantId) {
  // TOP_Y_OFFSET removed for spec alignment
  using ui::ALIGN_CENTER;
  using ui::ALIGN_LEFT;
  using ui::ALIGN_RIGHT;
  using ui::ComponentOps;
  using ui::OP_BATTERYGLYPH;
  using ui::OP_FILL;
  using ui::OP_ICONIN;
  using ui::OP_LINE;
  using ui::OP_SPARKLINE;
  using ui::OP_TEMPGROUPCENTERED;
  using ui::OP_TEXT;
  using ui::OP_TEXTCENTEREDIN;
  using ui::UiOpHeader;

  // Set up dual drawing to both display and screenshot canvas
  GFXcanvas1* canvas = display_capture_canvas();
  DualGFX gfx(&display, canvas);
  DualGFXScope gfx_scope(&gfx);  // Set global context for helper functions
  if (canvas) {
    // Fresh frame: the page loop clears the panel buffer, but nothing cleared
    // the mirror, so stale pixels from earlier draws ghosted into screenshots.
    canvas->fillScreen(1);  // 1 = white in the capture convention
    DisplayCapture::getInstance().setHasContent();
  }

  int comp_count = 0;
  const ComponentOps* comps = get_variant_ops(variantId, &comp_count);
  // Chrome (border, dividers) comes from each variant's spec component; the
  // hardcoded frame that used to be drawn here duplicated it on the data page
  // and drew stray lines through the graphs page, which has no divider.
  for (int ci = 0; ci < comp_count; ++ci) {
    const ComponentOps& co = comps[ci];
    for (int i = 0; i < co.count; ++i) {
      const UiOpHeader& op = co.ops[i];
      // s1 holds the spec's `when: has(<field>)` guard; skip the op when absent.
      if (op.s1 && !spec_field_has(op.s1))
        continue;
      switch (op.kind) {
        case ui::OP_SPARKLINE: {
          // 24h polyline, newest sample anchored at the right edge; series pairs
          // in the same chart share min/max so in/out are comparable. Dashed
          // (p1 of style: op.p0==1) draws 2-on/2-off segments - the 1-bit stand-in
          // for a second line style.
          const int* r = rect_ptr_by_id(op.rect);
          if (!r || !op.s0)
            break;
          HistoryRing& h = hist_ring();
          const int* rr = rect_ptr_by_id(op.rect);
          // Frame first so a freshly-booted (near-empty) ring still shows the
          // chart boxes instead of a blank page.
          gfx.drawRect(rr[0] - 1, rr[1] - 1, rr[2] + 2, rr[3] + 2, GxEPD_BLACK);
          if (h.count < 2)
            break;
          bool temp_group = (strncmp(op.s0, "hist_temp", 9) == 0);
          const float* series = nullptr;
          if (strcmp(op.s0, "hist_temp_in") == 0)
            series = h.temp_in;
          else if (strcmp(op.s0, "hist_temp_out") == 0)
            series = h.temp_out;
          else if (strcmp(op.s0, "hist_rh_in") == 0)
            series = h.rh_in;
          else if (strcmp(op.s0, "hist_rh_out") == 0)
            series = h.rh_out;
          if (!series)
            break;
          float mn = 0, mx = 0;
          bool ok = temp_group ? hist_minmax(h.temp_in, h.temp_out, &mn, &mx)
                               : hist_minmax(h.rh_in, h.rh_out, &mn, &mx);
          if (!ok)
            break;
          const int16_t x0 = r[0], y0 = r[1], w = r[2], hgt = r[3];
          int16_t px = 0, py = 0;
          bool have_prev = false;
          for (uint16_t i = 0; i < h.count; i++) {
            const float v = hist_at(series, i);
            if (!isfinite(v)) {
              have_prev = false;
              continue;
            }
            const int16_t cx = static_cast<int16_t>(
                x0 + (w - 1) - (int32_t)(h.count - 1 - i) * (w - 1) / (HIST_CAP - 1));
            const int16_t cy =
                static_cast<int16_t>(y0 + (hgt - 1) - (v - mn) / (mx - mn) * (hgt - 1));
            if (have_prev && (!op.p0 || (i % 4) < 2)) {
              gfx.drawLine(px, py, cx, cy, GxEPD_BLACK);
            }
            px = cx;
            py = cy;
            have_prev = true;
          }
          break;
        }
        case OP_FILL: {
          // Solid fill of the op's rect; p0=1 selects white. Basis of the
          // inverted header band and section tabs.
          const int* r = rect_ptr_by_id(op.rect);
          if (!r)
            break;
          gfx.fillRect(r[0], r[1], r[2], r[3], op.p0 ? GxEPD_WHITE : GxEPD_BLACK);
          break;
        }
        case ui::OP_FRAME: {
          // 1px outline of the op's rect (value chips, legend boxes).
          const int* r = rect_ptr_by_id(op.rect);
          if (!r)
            break;
          gfx.drawRect(r[0], r[1], r[2], r[3], GxEPD_BLACK);
          break;
        }
        case ui::OP_LINE: {
          int16_t x0 = op.p0, y0 = op.p1, x1 = op.p2, y1 = op.p3;
          // Ensure correct endpoint order for iteration
          if (x0 > x1) {
            int16_t t = x0;
            x0 = x1;
            x1 = t;
          }
          if (y0 > y1) {
            int16_t t = y0;
            y0 = y1;
            y1 = t;
          }
          if (y0 == y1) {
            for (int16_t x = x0; x <= x1; ++x) gfx.drawPixel(x, y0, GxEPD_BLACK);
          } else if (x0 == x1) {
            for (int16_t y = y0; y <= y1; ++y) gfx.drawPixel(x0, y, GxEPD_BLACK);
          }
          break;
        }
        case ui::OP_TEXT: {
          const int* r = rect_ptr_by_id(op.rect);
          int16_t tx = op.p0;
          int16_t ty = op.p1;
          String out = spec_expand_template(op.s0 ? String(op.s0) : String(""));
          // p3=1: inverse (white) text, drawn over an OP_FILL band.
          gfx.setTextColor(op.p3 ? GxEPD_WHITE : GxEPD_BLACK);
          gfx.setTextSize(1);
          // Handle rect-based positioning for all alignments (LEFT, RIGHT, CENTER)
          if (r && tx == 0) {
            int16_t tw = text_width_default_font(out.c_str(), 1);
            if (op.align == ALIGN_LEFT)
              tx = r[0] + 1;  // Left-align: start at rect's left edge
            else if (op.align == ALIGN_RIGHT)
              tx = r[0] + r[2] - 2 - tw;
            else if (op.align == ALIGN_CENTER)
              tx = r[0] + (r[2] - tw) / 2;
            // Use y-offset (p1) if provided, otherwise default to +1
            ty = r[1] + (op.p1 != 0 ? op.p1 : 1);
          }
          gfx.setCursor(tx, ty);
          gfx.print(out.c_str());
          break;
        }
        // OP_TIMERIGHT / OP_LABELCENTERED removed - no longer in ui_spec.json
        case OP_TEMPGROUPCENTERED: {
          const int* r = rect_ptr_by_id(op.rect);
          if (!r)
            break;
          char temp_buf[16];
          temp_buf[0] = 0;
          // Check by rect ID, not pointer comparison
          if (op.rect == ui::RECT_INSIDE_TEMP || op.rect == ui::RECT_INSIDE_TEMP_V3) {
            InsideReadings ir = read_inside_sensors();
            if (isfinite(ir.temperatureC)) {
              float tempF = ir.temperatureC * 9.0f / 5.0f + 32.0f;
              snprintf(temp_buf, sizeof(temp_buf), "%.0f", tempF);
            } else {
              snprintf(temp_buf, sizeof(temp_buf), "--");
            }
          } else if (op.rect == ui::RECT_OUT_TEMP || op.rect == ui::RECT_OUT_TEMP_V3) {
            OutsideReadings orr = net_get_outside();
            if (orr.validTemp && isfinite(orr.temperatureC)) {
              float tempF = orr.temperatureC * 9.0f / 5.0f + 32.0f;
              snprintf(temp_buf, sizeof(temp_buf), "%.0f", tempF);
            } else if (isfinite(get_last_outside_f())) {
              snprintf(temp_buf, sizeof(temp_buf), "%.0f", get_last_outside_f());
            } else {
              snprintf(temp_buf, sizeof(temp_buf), "--");
            }
          }
          // Use direct draw (no displayWindow call) during full refresh
          draw_temp_number_and_units_direct(r[0], r[1], r[2], r[3], temp_buf);
          break;
        }
        case OP_ICONIN: {
          const int* r = rect_ptr_by_id(op.rect);
          if (!r)
            break;
          OutsideReadings o = net_get_outside();
          if (o.validWeather && o.weather[0]) {
            draw_weather_icon_region_at(r[0], r[1], r[2], r[3], o.weather);
          }
          break;
        }
        // OP_SHORTCONDITION removed - no longer in ui_spec.json
        case OP_TEXTCENTEREDIN: {
          const int* r = rect_ptr_by_id(op.rect);
          if (!r)
            break;
          String out = spec_expand_template(op.s0 ? String(op.s0) : String(""));
          gfx.setTextColor(op.p3 ? GxEPD_WHITE : GxEPD_BLACK);
          gfx.setTextSize(1);
          int16_t tw = text_width_default_font(out.c_str(), 1);
          int16_t tx = r[0] + (r[2] - tw) / 2;
          int16_t ty = r[1] + op.p0;
          gfx.setCursor(tx, ty);
          gfx.print(out.c_str());
          break;
        }
        case OP_BATTERYGLYPH: {
          BatteryStatus bs = read_battery_status();
          int16_t bx = op.p0, by = op.p1, bw = op.p2, bh = op.p3;
          gfx.drawRect(bx, by, bw, bh, GxEPD_BLACK);
          gfx.fillRect(static_cast<int16_t>(bx + bw), static_cast<int16_t>(by + 2), 2, 3,
                       GxEPD_BLACK);
          // Clamp percent to 0-100 to prevent fill exceeding bounds
          int pct_clamped = (bs.percent > 100) ? 100 : ((bs.percent < 0) ? 0 : bs.percent);
          int16_t max_fillw = (bw > 2) ? static_cast<int16_t>(bw - 2) : 0;
          int16_t fillw = static_cast<int16_t>((max_fillw * (pct_clamped / 100.0f) + 0.5f));
          if (fillw > max_fillw)
            fillw = max_fillw;  // Safety clamp
          if (fillw > 0 && max_fillw > 0)
            gfx.fillRect(static_cast<int16_t>(bx + 1), static_cast<int16_t>(by + 1), fillw,
                         static_cast<int16_t>(bh - 2), GxEPD_BLACK);
          break;
        }
        default:
          break;
      }
    }
  }  // USE_UI_SPEC
}
#endif  // USE_UI_SPEC
#endif  // USE_DISPLAY

// partial_counter now managed by state_manager
// Wake count now managed by system_manager
// last_inside_f and last_outside_f moved to state_manager
// get_last_outside_f() now in state_manager
// last_outside_rh moved to state_manager
// State variables moved to state_manager module:
// - last_icon_id
// - last_footer_weather_crc
// - last_published_inside_tempC
// - last_published_inside_rh
// - last_published_inside_pressureHPa
// - last_status_crc
// last_inside_rh moved to state_manager

// Diagnostic counters moved to metrics_diagnostics module
// Diagnostic mode state moved to metrics_diagnostics module

// Memory monitoring structure
// MemoryDiagnostics struct moved to system_manager.h

// Timeout tracking
static uint32_t s_timeouts_mask = 0;

// Timeout bit constants
#define TIMEOUT_BIT_SENSOR 1
#define TIMEOUT_BIT_FETCH 2
#define TIMEOUT_BIT_DISPLAY 4
#define TIMEOUT_BIT_PUBLISH 8

// Layout version for device identity
#ifndef LAYOUT_VERSION
#define LAYOUT_VERSION 1
#endif
#ifndef LAYOUT_CRC
#define LAYOUT_CRC 0x08C0813Au
#endif

// Threshold constants for change detection
#ifndef THRESH_TEMP_C_FROM_F
#define THRESH_TEMP_C_FROM_F 0.5f
#endif
#ifndef THRESH_RH
#define THRESH_RH 1.0f
#endif
#ifndef THRESH_PRESS_HPA
#define THRESH_PRESS_HPA 1.0f
#endif

// Missing function implementations
// Moved to system_manager

// Forward declarations for functions used by print_boot_diagnostics
// get_last_outside_f() forward declaration now in state_manager
static const char* reset_reason_str(esp_reset_reason_t r);
static const char* wakeup_cause_str(esp_sleep_wakeup_cause_t c);

// Function moved to display_renderer module

static inline void net_publish_layout_identity() {
  if (!mqtt_is_connected())
    return;
  char topic[128];
  snprintf(topic, sizeof(topic), "%s/layout", rc_mqtt_pub_base());
  char payload[96];
  snprintf(payload, sizeof(payload), "{\"layout_version\":%u,\"layout_crc\":\"0x%08X\"}",
           static_cast<unsigned>(LAYOUT_VERSION), static_cast<unsigned>(LAYOUT_CRC));
  mqtt_publish_raw(topic, payload, true);
}
// needs_full_on_boot now managed in state_manager module
// g_full_only_mode now managed in state_manager module
#ifdef FORCE_FULL_ONLY
// Initialize at startup to force full refresh mode
static bool init_full_mode_at_start = []() {
  set_full_only_mode(true);
  return true;
}();
#endif

// Preferences object now managed in system_manager

// Implementation of NVS cache loading - uses RTC variables local to main.cpp
// Function moved to state_manager module
// print_boot_diagnostics now in system_manager

#if USE_DISPLAY
// Shared soft deadline used by display drawing helpers to avoid long loops
static uint32_t g_display_deadline_ms = 0;
// TOP_Y_OFFSET removed for spec alignment
#ifndef HEADER_NAME_Y_ADJ
#define HEADER_NAME_Y_ADJ -8  // Standardized with display_renderer.cpp and display_manager.cpp
#endif
#ifndef TEMP_Y_ADJ
#define TEMP_Y_ADJ -40
#endif
#ifndef TEMP_UNITS_Y_ADJ
#define TEMP_UNITS_Y_ADJ 20
#endif
#ifndef TEMP_DOWN_ADJ
#define TEMP_DOWN_ADJ 20
#endif
#ifndef STATUS_Y_ADJ
#define STATUS_Y_ADJ -4
#endif
#endif

// Function moved to metrics_diagnostics module

// Function moved to metrics_diagnostics module

// Map reset reason and wakeup cause to short strings for debug publishing
static const char* reset_reason_str(esp_reset_reason_t r) {
  switch (r) {
    case ESP_RST_POWERON:
      return "ESP_RST_POWERON";
    case ESP_RST_EXT:
      return "ESP_RST_EXT";
    case ESP_RST_SW:
      return "ESP_RST_SW";
    case ESP_RST_PANIC:
      return "ESP_RST_PANIC";
    case ESP_RST_INT_WDT:
      return "ESP_RST_INT_WDT";
    case ESP_RST_TASK_WDT:
      return "ESP_RST_TASK_WDT";
    case ESP_RST_WDT:
      return "ESP_RST_WDT";
    case ESP_RST_BROWNOUT:
      return "ESP_RST_BROWNOUT";
    case ESP_RST_DEEPSLEEP:
      return "ESP_RST_DEEPSLEEP";
    case ESP_RST_SDIO:
      return "ESP_RST_SDIO";
    default:
      return "ESP_RST_UNKNOWN";
  }
}

// Function moved to metrics_diagnostics module

static const char* wakeup_cause_str(esp_sleep_wakeup_cause_t c) {
  switch (c) {
    case ESP_SLEEP_WAKEUP_UNDEFINED:
      return "UNDEFINED";
    case ESP_SLEEP_WAKEUP_EXT0:
      return "EXT0";
    case ESP_SLEEP_WAKEUP_EXT1:
      return "EXT1";
    case ESP_SLEEP_WAKEUP_TIMER:
      return "TIMER";
    case ESP_SLEEP_WAKEUP_TOUCHPAD:
      return "TOUCHPAD";
    case ESP_SLEEP_WAKEUP_ULP:
      return "ULP";
#ifdef ESP_SLEEP_WAKEUP_GPIO
    case ESP_SLEEP_WAKEUP_GPIO:
      return "GPIO";
#endif
#ifdef ESP_SLEEP_WAKEUP_UART
    case ESP_SLEEP_WAKEUP_UART:
      return "UART";
#endif
    default:
      return "OTHER";
  }
}

// Moved to display_manager.cpp

// Moved to display_manager.cpp

#if USE_DISPLAY
// Forward declaration for status drawing used by maybe_redraw_status
// draw_status_line moved to display_renderer module

template <typename DrawFn>
static inline void draw_in_region(const int rect[4],

                                  DrawFn drawFn) {
  const int16_t x = rect[0];
  const int16_t y = rect[1];
  const int16_t w = rect[2];
  const int16_t h = rect[3];
  // Align partial window to 8-pixel byte boundaries on X for SSD1680-class
  // panels
  // to avoid controller rejects or missing updates on unaligned windows.
  int16_t ax = x & ~0x07;
  int16_t ar = x + w;  // right edge (exclusive)
  int16_t aw = static_cast<int16_t>(((ar - ax) + 7) & ~0x07);
  display.setPartialWindow(ax, y, aw, h);
  display.firstPage();
  do {
    display.fillScreen(GxEPD_WHITE);
    drawFn(x, y, w, h);
    yield();
  } while (display.nextPage());
}

static inline void draw_right_aligned_text_in_rect(const int rect[4], const char* text,
                                                   uint8_t textSize, int16_t paddingRight,
                                                   int16_t baselineOffset) {
  draw_in_region(rect, [&](int16_t x, int16_t y, int16_t w, int16_t h) {
    display.setTextColor(GxEPD_BLACK);
    display.setTextSize(textSize);
    int16_t tw = text_width_default_font(text, textSize);
    int16_t rx = x + w - paddingRight - tw;
    int16_t by = y + h - baselineOffset;
    display.setCursor(rx, by);
    display.print(text);
  });
}

// Function moved to display_renderer module

// Function moved to display_renderer module

// fast_crc32 function moved to system_manager module

template <typename DrawFn>
static inline bool maybe_redraw_numeric(const int rect[4], float currentValue, float& lastValue,
                                        float threshold, DrawFn drawFn) {
  bool should = false;
  if (!isnan(currentValue) &&
      (!isfinite(lastValue) || fabsf(currentValue - lastValue) >= threshold))
    should = true;
  if (should) {
    drawFn();
    lastValue = currentValue;
    return true;
  }
  return false;
}

template <typename T, typename DrawFn>
static inline bool maybe_redraw_value(const int rect[4], const T& currentValue, T& lastValue,
                                      DrawFn drawFn) {
  if (currentValue != lastValue) {
    drawFn();
    lastValue = currentValue;
    return true;
  }
  return false;
}

static inline bool maybe_redraw_status(const BatteryStatus& bs, const char* ip_cstr,
                                       const int rect[4]) {
  char buf[96];
  // Stacked footer signature (3-row status)
  snprintf(buf, sizeof(buf), "B%.2f|%d|D%d|IP%s", bs.voltage, bs.percent, bs.estimatedDays,
           ip_cstr);
  uint32_t crc = fast_crc32((const uint8_t*)buf, strlen(buf));
  if (crc != get_last_status_crc()) {
    draw_status_line(bs, ip_cstr);
    set_last_status_crc(crc);
    return true;
  }
  return false;
}

// Moved to display_manager.cpp

// Function moved to display_renderer module

// Moved to display_manager.cpp

// Function moved to display_renderer module

// Moved to display_manager.cpp
#endif  // USE_DISPLAY guard for draw_in_region template and related functions

#if USE_DISPLAY
// Function moved to display_renderer module

// map_weather_to_icon function moved to display_renderer module

// map_openweather_to_icon function moved to display_renderer module
#endif  // USE_DISPLAY

// Draw weather icon region using OutsideReadings object (prefer OpenWeather
// hints)
#if USE_DISPLAY
// Functions moved to display_renderer module

// Function moved to display_renderer module

// Function moved to display_renderer module

// Removed minimal debug full_refresh

#endif  // USE_DISPLAY

#if USE_DISPLAY && DEV_NO_SLEEP
// Periodic UI updater for always-on display build. Applies partial redraws when
// outside MQTT values change beyond thresholds. Also refreshes header time and
// status line opportunistically.
#endif  // USE_DISPLAY && DEV_NO_SLEEP

// No LOG_MODULE("MAIN") here: this file makes no LOGM_* calls, so registering a
// module id would just be an unused file-scope static.

// Original setup has been moved to app_controller.cpp
// The full implementation is now in app_controller.cpp
// See git history for the original 721-line setup() function

// ============= MAIN ENTRY POINTS =============

// Simplified setup - delegates to app_controller
void setup() { app_setup(); }

void loop() {
  // Main loop logic moved to app_controller
  app_loop();
}
