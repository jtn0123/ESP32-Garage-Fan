// Display rendering implementation
#include "display_renderer.h"

#if USE_DISPLAY

#include <GxEPD2_BW.h>
#include <cstdio>
#include "display_layout.h"
#include "display_layout_aliases.h"
#include "display_manager.h"
#include "icons.h"
#include "generated_config.h"
#include "ui_ops_generated.h"
#if USE_UI_SPEC
#include "ui_generated.h"
using namespace ui;  // NOLINT(build/namespaces) - namespace is generated by gen_ui.py
#endif
#include "net.h"
#include "metrics_diagnostics.h"
#include "sensors.h"
#include "power.h"
#include "common_types.h"
#include "state_manager.h"
#include "safe_strings.h"
#include "display_smart_refresh.h"
#include "profiling.h"
#include "display_capture.h"
#include "dual_gfx.h"

// Helper macro: draw to both display and screenshot canvas if context is set
#define DUAL_DRAW(method, ...)                   \
  do {                                           \
    display.method(__VA_ARGS__);                 \
    DualGFX* _ctx = get_dual_gfx_context();      \
    if (_ctx && _ctx->getSecondary()) {          \
      _ctx->getSecondary()->method(__VA_ARGS__); \
    }                                            \
  } while (0)

// For setTextColor which takes a GxEPD color that needs mapping to canvas color
#define DUAL_SET_TEXT_COLOR(color)                  \
  do {                                              \
    display.setTextColor(color);                    \
    DualGFX* _ctx = get_dual_gfx_context();         \
    if (_ctx && _ctx->getSecondary()) {             \
      uint16_t _mapped = (color == 0xFFFF) ? 1 : 0; \
      _ctx->getSecondary()->setTextColor(_mapped);  \
    }                                               \
  } while (0)

// External display object from main.cpp; type selected in display_hw.h.
#include "display_hw.h"

// External variables from main.cpp
extern float get_last_outside_f();

// Constants for display layout
#define HEADER_NAME_Y_ADJ -8
#define STATUS_Y_ADJ -4

// Rectangle aliases for backward compatibility
// Layout variables are now defined without RECT_ prefix in display_layout.h
// Using them directly - no aliases needed
#define OUT_RH OUT_HUMIDITY
#define FOOTER_R FOOTER_WEATHER
#define STATUS_ FOOTER_STATUS

// Implementation for draw_in_region with lambda that takes coordinates
void draw_in_region(const int rect[4], DrawFnLambda drawFn) {
  int16_t x = rect[0];
  int16_t y = rect[1];
  int16_t w = rect[2];
  int16_t h = rect[3];

  // Clear the region
  display.fillRect(x, y, w, h, GxEPD_WHITE);

  // Call the drawing function with coordinates
  drawFn(x, y, w, h);

  // Update the display window
  display.displayWindow(x, y, w, h);
}

// Implementation for draw_in_region with simple function
void draw_in_region(const int rect[4], DrawFnFwd drawFn) {
  int16_t x = rect[0];
  int16_t y = rect[1];
  int16_t w = rect[2];
  int16_t h = rect[3];

  // Clear the region
  display.fillRect(x, y, w, h, GxEPD_WHITE);

  // Call the drawing function (no parameters)
  drawFn();

  // Update the display window
  display.displayWindow(x, y, w, h);
}

// Template version for lambda functions with captures
template <typename DrawFn>
inline void draw_in_region(const int rect[4], DrawFn drawFn) {
  const int16_t x = rect[0];
  const int16_t y = rect[1];
  const int16_t w = rect[2];
  const int16_t h = rect[3];

  // Align partial window to 8-pixel byte boundaries on X for SSD1680-class panels
  int16_t ax = x & ~0x07;
  int16_t ar = x + w;  // right edge (exclusive)
  int16_t aw = static_cast<int16_t>(((ar - ax) + 7) & ~0x07);

  display.setPartialWindow(ax, y, aw, h);
  display.firstPage();
  do {
    display.fillScreen(GxEPD_WHITE);
    drawFn(x, y, w, h);
    yield();
  } while (display.nextPage());
}

// Helper to draw right-aligned text
void draw_right_aligned_text_in_rect(const int rect[4], const char* text, int16_t text_width) {
  int16_t x = rect[0];
  int16_t y = rect[1];
  int16_t w = rect[2];
  int16_t h = rect[3];

  display.setTextColor(GxEPD_BLACK);
  display.setTextSize(1);
  display.setCursor(x + w - text_width - 2, y + h - 6);
  display.print(text);
}

// Draw temperature with units
void draw_temp_number_and_units(const int r[4], const char* t) {
  draw_in_region(r, [&](int16_t x, int16_t y, int16_t w, int16_t h) {
    DUAL_SET_TEXT_COLOR(GxEPD_BLACK);
    DUAL_DRAW(setTextSize, 2);

    int16_t x1, y1;
    uint16_t bw, bh;
    display.getTextBounds(t, 0, 0, &x1, &y1, &bw, &bh);

    int16_t targetX = x + (w - static_cast<int16_t>(bw)) / 2;
    int16_t targetY = y + (h - static_cast<int16_t>(bh)) / 2;
    int16_t baseX = targetX - x1;
    int16_t baseY = targetY - y1;

    DUAL_DRAW(setCursor, baseX, baseY);
    DUAL_DRAW(print, t);

    // Draw units
    DUAL_DRAW(setTextSize, 1);
    DUAL_DRAW(setCursor, baseX + static_cast<int16_t>(bw) + 2, baseY - 8);
    DUAL_DRAW(print, "\xF8");
    DUAL_DRAW(setCursor, baseX + static_cast<int16_t>(bw) + 8, baseY - 8);
    DUAL_DRAW(print, "F");
  });
}

// Direct temperature drawing (without region clearing)
void draw_temp_number_and_units_direct(int16_t x, int16_t y, int16_t w, int16_t h, const char* t,
                                       uint16_t color) {
  DUAL_SET_TEXT_COLOR(color);
  // Tall rects (v3) get size-3 digits (21 px), matching the sim's 22 px "big"
  // font; the v2 rects keep the size-2 look they were tuned for.
  const uint8_t ts = (h >= 32) ? 3 : 2;
  DUAL_DRAW(setTextSize, ts);

  int16_t x1, y1;
  uint16_t bw, bh;
  display.getTextBounds(t, 0, 0, &x1, &y1, &bw, &bh);

  int16_t targetX = x + (w - static_cast<int16_t>(bw)) / 2;
  int16_t targetY = y + (h - static_cast<int16_t>(bh)) / 2;
  int16_t baseX = targetX - x1;
  int16_t baseY = targetY - y1;

  DUAL_DRAW(setCursor, baseX, baseY);
  DUAL_DRAW(print, t);

  // Draw units (degree symbol and F)
  DUAL_DRAW(setTextSize, 1);
  DUAL_DRAW(setCursor, baseX + static_cast<int16_t>(bw) + 2, baseY - 8);
  DUAL_DRAW(print, "\xF8");  // degree symbol
  DUAL_DRAW(setCursor, baseX + static_cast<int16_t>(bw) + 8, baseY - 8);
  DUAL_DRAW(print, "F");
}

// Draw header time
void draw_header_time(const char* time_str) {
  // For display_renderer, we call the direct function without region management
  // Region management is handled by the calling context (full refresh, etc.)
  draw_header_time_direct(time_str);
}

// Draw status line with battery and IP
void draw_status_line(const BatteryStatus& bs, const char* ip_cstr) {
  // For display_renderer, we call the direct function without region management
  // Region management is handled by the calling context (full refresh, etc.)
  draw_status_line_direct(bs, ip_cstr);
}

// Draw weather icon based on condition string
void draw_weather_icon_region_at(int16_t x, int16_t y, int16_t w, int16_t h,
                                 const char* condition, uint16_t color) {
  if (!condition)
    return;

  // Map condition to icon ID
  IconId iconId = map_weather_to_icon(condition);

  // Center the baked icon within the region using generated dimensions
  // Clamp positions to prevent drawing outside intended region when icon > region
  int16_t icon_x = x + (w - ICON_W) / 2;
  int16_t icon_y = y + (h - ICON_H) / 2;
  if (icon_x < x)
    icon_x = x;  // Don't go left of region
  if (icon_y < y)
    icon_y = y;  // Don't go above region

  // Draw the icon to display
  draw_icon(display, icon_x, icon_y, iconId, color);

  // Also draw to screenshot canvas if context is set
  DualGFX* ctx = get_dual_gfx_context();
  if (ctx && ctx->getSecondary()) {
    draw_icon(*ctx->getSecondary(), icon_x, icon_y, iconId, 0);  // 0 = black for canvas
  }
}

// Draw weather icon from outside readings
void draw_weather_icon_region_at_from_outside(int16_t x, int16_t y, int16_t w, int16_t h,
                                              const OutsideReadings& outh) {
  if (outh.validWeather && outh.weather[0]) {
    draw_weather_icon_region_at(x, y, w, h, outh.weather);
  }
}

// Forward declaration for spec-based rendering (implemented in main.cpp)
#if USE_UI_SPEC
extern void draw_from_spec_full_impl(uint8_t variantId);
#endif

// --- display page state ------------------------------------------------------
// Page 0 = live data (defaultVariant), page 1 = 24h graphs ("v3g"). Toggled on
// the refresh cadence and by the BOOT button / MQTT cmd.
static uint8_t g_ui_page = 0;

uint8_t display_current_page() { return g_ui_page; }

void display_toggle_page() { g_ui_page ^= 1; }

static uint8_t variant_id_for_page(uint8_t page) {
  if (page == 0)
    return ui::kDefaultVariantId;
  constexpr size_t n = sizeof(ui::kVariantNames) / sizeof(ui::kVariantNames[0]);
  for (size_t i = 0; i < n; i++) {
    if (strcmp(ui::kVariantNames[i], "v3g") == 0)
      return static_cast<uint8_t>(i);
  }
  return ui::kDefaultVariantId;  // no graphs variant in this spec build
}

// Flash-free partial update of the live-data area (header stamp + both panes).
// The trick: run the FULL spec draw inside a partial window - GxEPD2 clips all
// drawing to the window, so ops outside it cost CPU but touch no pixels, and
// everything inside (band segment, white stamp, temps, meta rows) renders with
// zero special-casing. The mirror canvas receives the complete frame, so
// remote screenshots stay exact. SSD1680 fast-partial takes ~300 ms with no
// black flash and spends no full-refresh cycle.
void display_partial_update_live() {
#if USE_UI_SPEC
  if (!kDisplayHasFastPartial)
    return;  // tri-color: "partial" is a full 15 s flash; wait for the
             // scheduled full refresh instead of flashing every sample
  if (display_current_page() != 0)
    return;  // graphs page changes shape too much; it waits for its full draw

  // Ghost hygiene: differential updates accumulate faint residue, so after
  // FULL_REFRESH_EVERY partials do a proper full instead. In practice the
  // 15-minute page alternation resets the counter long before this trips -
  // it is a safety net for a future where alternation is disabled.
  if (get_partial_counter() >= FULL_REFRESH_EVERY) {
    full_refresh();
    return;
  }

  display.setPartialWindow(0, 0, EINK_WIDTH, 84);
  display.firstPage();
  do {
    display.fillScreen(GxEPD_WHITE);
    draw_from_spec_full_impl(variant_id_for_page(0));
  } while (display.nextPage());
  increment_partial_counter();
#endif
}

// Full display refresh
void full_refresh() {
  PROFILE_SCOPE("full_refresh");

#if USE_UI_SPEC
  // Use spec-based rendering for simulator/device parity
  display.setFullWindow();
  display.firstPage();

  do {
    display.fillScreen(GxEPD_WHITE);
    // draw_from_spec_full_impl sets up DualGFX context and draws to both
    // display and screenshot canvas
    draw_from_spec_full_impl(variant_id_for_page(g_ui_page));
  } while (display.nextPage());
  reset_partial_counter();
  return;
#else
// The legacy hardcoded renderer that lived here was removed: every env that
// compiles this file sets USE_UI_SPEC=1, so it had been unreachable dead code
// (~190 lines) since the spec renderer landed. Fail loudly rather than silently
// resurrecting a second, divergent layout implementation.
#error "full_refresh() requires USE_UI_SPEC=1 (legacy renderer removed)"
#endif
}

// Smoke test for display
void smoke_full_window_test() {
  Serial.println(F("Display smoke test"));
  display.setFullWindow();
  display.firstPage();
  do {
    display.fillScreen(GxEPD_WHITE);
    display.setTextColor(GxEPD_BLACK);
    display.setTextSize(2);
    display.setCursor(20, 60);
    display.print(F("ESP32 READY"));
  } while (display.nextPage());
}

// Draw from UI spec (generated UI)
// Note: Full implementation is in main.cpp (draw_from_spec_full_impl)
// This stub is kept for backward compatibility
void draw_from_spec_full(uint8_t variantId) {
#if USE_UI_SPEC
  // Delegate to the full implementation in main.cpp
  extern void draw_from_spec_full_impl(uint8_t variantId);
  draw_from_spec_full_impl(variantId);
#endif
}

// Weather icon mapping functions
IconId map_weather_to_icon(const char* w) {
  String s(w);
  s.toLowerCase();
  // First handle Home Assistant recommended values exactly

  // https://developers.home-assistant.io/docs/core/entity/weather/#recommended-values-for-state-and-condition
  if (s == "clear-night")
    return ICON_WEATHER_NIGHT;
  if (s == "cloudy")
    return ICON_WEATHER_CLOUDY;
  if (s == "exceptional")
    return ICON_WEATHER_CLOUDY;  // generic fallback
  if (s == "fog")
    return ICON_WEATHER_FOG;
  if (s == "hail")
    return ICON_WEATHER_SNOWY;  // approximate
  if (s == "lightning")
    return ICON_WEATHER_LIGHTNING;
  if (s == "lightning-rainy")
    return ICON_WEATHER_LIGHTNING;  // prefer lightning cue
  if (s == "partlycloudy")
    return ICON_WEATHER_PARTLY_CLOUDY;
  if (s == "pouring")
    return ICON_WEATHER_POURING;
  if (s == "rainy")
    return ICON_WEATHER_POURING;
  if (s == "snowy")
    return ICON_WEATHER_SNOWY;
  if (s == "snowy-rainy")
    return ICON_WEATHER_SNOWY;  // approximate
  if (s == "sunny")
    return ICON_WEATHER_SUNNY;
  if (s == "windy" || s == "windy-variant")
    return ICON_WEATHER_CLOUDY;  // approximate
  // Also accept explicit MDI icon names if passed through
  if (s == "weather-sunny")
    return ICON_WEATHER_SUNNY;
  if (s == "weather-partly-cloudy")
    return ICON_WEATHER_PARTLY_CLOUDY;
  if (s == "weather-cloudy")
    return ICON_WEATHER_CLOUDY;
  if (s == "weather-fog")
    return ICON_WEATHER_FOG;
  if (s == "weather-pouring" || s == "weather-rainy")
    return ICON_WEATHER_POURING;
  if (s == "weather-snowy")
    return ICON_WEATHER_SNOWY;
  if (s == "weather-lightning")
    return ICON_WEATHER_LIGHTNING;
  if (s == "weather-night")
    return ICON_WEATHER_NIGHT;
  if (s == "weather-night-partly-cloudy")
    return ICON_WEATHER_NIGHT_PARTLY_CLOUDY;
  if (s.indexOf("tornado") >= 0)
    return ICON_WEATHER_TORNADO;
  if (s.indexOf("hurricane") >= 0)
    return ICON_WEATHER_HURRICANE;
  if (s.indexOf("drizzle") >= 0)
    return ICON_WEATHER_DRIZZLE;
  if (s.indexOf("storm") >= 0 || s.indexOf("thunder") >= 0 || s.indexOf("lightning") >= 0) {
    return ICON_WEATHER_LIGHTNING;
  }
  if (s.indexOf("pour") >= 0 || s.indexOf("rain") >= 0 || s.indexOf("shower") >= 0) {
    return ICON_WEATHER_POURING;
  }
  if (s.indexOf("snow") >= 0)
    return ICON_WEATHER_SNOWY;
  if (s.indexOf("fog") >= 0 || s.indexOf("mist") >= 0 || s.indexOf("haze") >= 0)
    return ICON_WEATHER_FOG;
  if (s.indexOf("part") >= 0)
    return ICON_WEATHER_PARTLY_CLOUDY;
  if (s.indexOf("cloud") >= 0 || s.indexOf("overcast") >= 0)
    return ICON_WEATHER_CLOUDY;
  if (s.indexOf("night") >= 0)
    return ICON_WEATHER_NIGHT;
  return ICON_WEATHER_SUNNY;
}

// Draw sensor values on display
void draw_values(const char* in_temp_f, const char* in_rh, const char* out_temp_f,
                 const char* out_rh, const char* time_str, const char* status) {
  display.setTextColor(GxEPD_BLACK);
  // Inside temp: numeric right-aligned, units drawn separately
  {
    int rect[4] = {INSIDE_TEMP[0], INSIDE_TEMP[1], INSIDE_TEMP[2], INSIDE_TEMP[3]};
    draw_temp_number_and_units(rect, in_temp_f);
  }

  // Inside RH
  display.setTextSize(1);
  display.setCursor(INSIDE_HUMIDITY[0], INSIDE_HUMIDITY[1] + INSIDE_HUMIDITY[3] - 4);
  display.print(in_rh);
  display.print("% RH");

  // No duplicate inside time; header time is drawn by draw_header_time

  // Outside temp: numeric right-aligned, units drawn separately
  {
    int rect[4] = {OUT_TEMP[0], OUT_TEMP[1], OUT_TEMP[2], OUT_TEMP[3]};
    draw_temp_number_and_units(rect, out_temp_f);
  }

  // Other fields (condition, RH, wind) drawn with their partial updaters
  // Status line drawn separately by partial
}

#if USE_UI_SPEC
// Map RectId -> rect geometry via the generated table. This used to be a
// hand-maintained switch that silently returned nullptr for any rect added
// after it was written — every op targeting a v3 rect drew at (0,0) or not at
// all on the device while the sim rendered perfectly.
const int* rect_ptr_by_id(uint8_t rid) {
  if (rid >= ui::RECT__COUNT)
    return nullptr;
  return ui::kRectTable[rid];
}
#endif

#endif  // USE_DISPLAY
